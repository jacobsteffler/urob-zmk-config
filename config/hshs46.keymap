#define CONFIG_WIRELESS
#define ZMK_BASE_LAYER(name, LT, RT, LM, RM, LB, RB, LH, RH)                   \
    ZMK_LAYER(                                                                 \
        name,                                                                  \
                 &none LT             RT &none                                 \
                 &none LM             RM &none                                 \
                 &none LB &none &none RB &none                                 \
                 &none LH &none &none RH &none                                 \
    )

#include "zmk-helpers/key-labels/hillside46.h"
#include "base.keymap"
